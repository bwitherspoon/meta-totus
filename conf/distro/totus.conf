## conf/distro/totus.conf
```bitbake
require conf/distro/poky.conf

DISTRO = "totus"
DISTRO_NAME = "Totus"
SDK_VENDOR = "-totussdk"

MAINTAINER = "Brett Witherspoon <spoonb@cdspooner.com>"

TARGET_VENDOR = "-totus"

DISTRO_FEATURES_append = " systemd"
DISTRO_FEATURES_remove = "x11"
DISTRO_FEATURES_BACKFILL_CONSIDERED_append = " sysvinit"

INHERIT += "blacklist"
PNBLACKLIST[busybox] = "Not supported."

PREFERRED_PROVIDER_virtual/base-utils = "coreutils"

VIRTUAL-RUNTIME_init_manager = "systemd"
VIRTUAL-RUNTIME_initscripts = ""
VIRTUAL-RUNTIME_base-utils = "coreutils"
VIRTUAL-RUNTIME_base-utils-hwclock = "util-linux-hwclock"
VIRTUAL-RUNTIME_base-utils-syslog = ""
VIRTUAL-RUNTIME_login_manager = "shadow-base"
VIRTUAL-RUNTIME_syslog = ""
```

## conf/layer.conf
```bitbake
# We have a conf and classes directory, add to BBPATH
BBPATH .= ":${LAYERDIR}"

LAYERDEPENDS_totus = "core"
LAYERSERIES_COMPAT_totus = "thud"
```
